## components/sd_storage_service/Kconfig
```kconfig
menu "SD storage service"

    config SD_STORAGE_SERVICE_ENABLE
        bool "Enable removable SD storage service"
        default y

    config SD_STORAGE_SERVICE_MOUNT_PATH
        string "SD filesystem mount path"
        default "/sdcard"
        help
            VFS path used for the removable SD filesystem.

    config SD_STORAGE_SERVICE_FORMAT_IF_MOUNT_FAILED
        bool "Format SD card when mounting fails"
        default n
        help
            Formatting is destructive. Keep this disabled for production
            devices unless an explicit recovery workflow enables it.

    config SD_STORAGE_SERVICE_MAX_FILES
        int "Maximum open SD files"
        range 1 32
        default 5

    choice SD_STORAGE_SERVICE_ALLOCATION_UNIT
        prompt "FAT allocation unit size"
        default SD_STORAGE_SERVICE_ALLOCATION_UNIT_16384

        config SD_STORAGE_SERVICE_ALLOCATION_UNIT_AUTO
            bool "Automatic"
        config SD_STORAGE_SERVICE_ALLOCATION_UNIT_512
            bool "512 bytes"
        config SD_STORAGE_SERVICE_ALLOCATION_UNIT_1024
            bool "1 KiB"
        config SD_STORAGE_SERVICE_ALLOCATION_UNIT_2048
            bool "2 KiB"
        config SD_STORAGE_SERVICE_ALLOCATION_UNIT_4096
            bool "4 KiB"
        config SD_STORAGE_SERVICE_ALLOCATION_UNIT_8192
            bool "8 KiB"
        config SD_STORAGE_SERVICE_ALLOCATION_UNIT_16384
            bool "16 KiB"
        config SD_STORAGE_SERVICE_ALLOCATION_UNIT_32768
            bool "32 KiB"
        config SD_STORAGE_SERVICE_ALLOCATION_UNIT_65536
            bool "64 KiB"
    endchoice

    config SD_STORAGE_SERVICE_ALLOCATION_UNIT_SIZE
        int
        default 0 if SD_STORAGE_SERVICE_ALLOCATION_UNIT_AUTO
        default 512 if SD_STORAGE_SERVICE_ALLOCATION_UNIT_512
        default 1024 if SD_STORAGE_SERVICE_ALLOCATION_UNIT_1024
        default 2048 if SD_STORAGE_SERVICE_ALLOCATION_UNIT_2048
        default 4096 if SD_STORAGE_SERVICE_ALLOCATION_UNIT_4096
        default 8192 if SD_STORAGE_SERVICE_ALLOCATION_UNIT_8192
        default 16384 if SD_STORAGE_SERVICE_ALLOCATION_UNIT_16384
        default 32768 if SD_STORAGE_SERVICE_ALLOCATION_UNIT_32768
        default 65536 if SD_STORAGE_SERVICE_ALLOCATION_UNIT_65536

endmenu
```

## components/system_pm/Kconfig
```kconfig
menu "System Power Management"

    config SYSTEM_PM_STANDBY_TASK_STACK
        int "Standby task stack size (bytes)"
        range 2048 16384
        default 4096
        help
            Stack size for the system_pm standby FreeRTOS task.

endmenu
```

## components/time_service/Kconfig
```kconfig
menu "Time service resources"

config TIME_SERVICE_SYNC_WORKER_STACK
    int "SNTP worker stack size"
    range 2048 8192
    default 3072

endmenu
```

## components/weather_service/Kconfig
```kconfig
menu "Weather service resources"

config WEATHER_SERVICE_TASK_STACK_SIZE
    int "Weather worker stack size"
    range 4096 16384
    default 8192

config WEATHER_SERVICE_MAX_RESPONSE_BYTES
    int "Maximum temporary HTTP response bytes"
    range 65536 524288
    default 262144

endmenu
```

## components/wifi_service/Kconfig
```kconfig
menu "MicroTech WiFi service"

config WIFI_SERVICE_TASK_STACK
    int "Worker stack depth"
    default 4096
    range 3072 8192

config WIFI_SERVICE_QUEUE_DEPTH
    int "Async command/event queue depth"
    default 16
    range 1 64

endmenu
```
