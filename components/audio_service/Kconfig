## components/audio_service/Kconfig
```kconfig
menu "Audio service"
    choice AUDIO_SERVICE_SAMPLE_RATE
        prompt "Default sample rate"
        default AUDIO_SERVICE_SAMPLE_RATE_16000

        config AUDIO_SERVICE_SAMPLE_RATE_8000
            bool "8 kHz"
        config AUDIO_SERVICE_SAMPLE_RATE_11025
            bool "11.025 kHz"
        config AUDIO_SERVICE_SAMPLE_RATE_12000
            bool "12 kHz"
        config AUDIO_SERVICE_SAMPLE_RATE_16000
            bool "16 kHz"
        config AUDIO_SERVICE_SAMPLE_RATE_22050
            bool "22.05 kHz"
        config AUDIO_SERVICE_SAMPLE_RATE_24000
            bool "24 kHz"
        config AUDIO_SERVICE_SAMPLE_RATE_32000
            bool "32 kHz"
        config AUDIO_SERVICE_SAMPLE_RATE_44100
            bool "44.1 kHz"
        config AUDIO_SERVICE_SAMPLE_RATE_48000
            bool "48 kHz"
        config AUDIO_SERVICE_SAMPLE_RATE_64000
            bool "64 kHz"
        config AUDIO_SERVICE_SAMPLE_RATE_88200
            bool "88.2 kHz"
        config AUDIO_SERVICE_SAMPLE_RATE_96000
            bool "96 kHz"
    endchoice

    config AUDIO_SERVICE_SAMPLE_RATE_HZ
        int
        default 8000 if AUDIO_SERVICE_SAMPLE_RATE_8000
        default 11025 if AUDIO_SERVICE_SAMPLE_RATE_11025
        default 12000 if AUDIO_SERVICE_SAMPLE_RATE_12000
        default 16000 if AUDIO_SERVICE_SAMPLE_RATE_16000
        default 22050 if AUDIO_SERVICE_SAMPLE_RATE_22050
        default 24000 if AUDIO_SERVICE_SAMPLE_RATE_24000
        default 32000 if AUDIO_SERVICE_SAMPLE_RATE_32000
        default 44100 if AUDIO_SERVICE_SAMPLE_RATE_44100
        default 48000 if AUDIO_SERVICE_SAMPLE_RATE_48000
        default 64000 if AUDIO_SERVICE_SAMPLE_RATE_64000
        default 88200 if AUDIO_SERVICE_SAMPLE_RATE_88200
        default 96000 if AUDIO_SERVICE_SAMPLE_RATE_96000

    choice AUDIO_SERVICE_SAMPLE_WIDTH
        prompt "Default sample width"
        default AUDIO_SERVICE_BITS_16

        config AUDIO_SERVICE_BITS_16
            bool "16-bit"
        config AUDIO_SERVICE_BITS_24
            bool "24-bit"
            depends on AUDIO_SERVICE_SAMPLE_RATE_8000 || \
                       AUDIO_SERVICE_SAMPLE_RATE_16000 || \
                       AUDIO_SERVICE_SAMPLE_RATE_24000 || \
                       AUDIO_SERVICE_SAMPLE_RATE_32000 || \
                       AUDIO_SERVICE_SAMPLE_RATE_48000 || \
                       AUDIO_SERVICE_SAMPLE_RATE_64000 || \
                       AUDIO_SERVICE_SAMPLE_RATE_96000
        config AUDIO_SERVICE_BITS_32
            bool "32-bit"
    endchoice

    config AUDIO_SERVICE_BITS_PER_SAMPLE
        int
        default 16 if AUDIO_SERVICE_BITS_16
        default 24 if AUDIO_SERVICE_BITS_24
        default 32 if AUDIO_SERVICE_BITS_32

    choice AUDIO_SERVICE_CHANNEL_COUNT
        prompt "Default channel count"
        default AUDIO_SERVICE_CHANNELS_2

        config AUDIO_SERVICE_CHANNELS_1
            bool "Mono"
        config AUDIO_SERVICE_CHANNELS_2
            bool "Stereo"
    endchoice

    config AUDIO_SERVICE_CHANNELS
        int
        default 1 if AUDIO_SERVICE_CHANNELS_1
        default 2 if AUDIO_SERVICE_CHANNELS_2

    choice AUDIO_SERVICE_MCLK_RATIO
        prompt "Default MCLK multiple"
        default AUDIO_SERVICE_MCLK_384 if AUDIO_SERVICE_SAMPLE_RATE_8000 || \
                                                AUDIO_SERVICE_SAMPLE_RATE_16000 || \
                                                AUDIO_SERVICE_SAMPLE_RATE_32000 || \
                                                AUDIO_SERVICE_SAMPLE_RATE_48000
        default AUDIO_SERVICE_MCLK_768 if AUDIO_SERVICE_BITS_24 && \
                                               AUDIO_SERVICE_SAMPLE_RATE_24000
        default AUDIO_SERVICE_MCLK_192 if AUDIO_SERVICE_BITS_24
        default AUDIO_SERVICE_MCLK_128 if AUDIO_SERVICE_SAMPLE_RATE_88200
        default AUDIO_SERVICE_MCLK_256

        config AUDIO_SERVICE_MCLK_128
            bool "128x"
            depends on !AUDIO_SERVICE_BITS_24
        config AUDIO_SERVICE_MCLK_192
            bool "192x"
            depends on AUDIO_SERVICE_SAMPLE_RATE_8000 || \
                       AUDIO_SERVICE_SAMPLE_RATE_16000 || \
                       AUDIO_SERVICE_SAMPLE_RATE_32000 || \
                       AUDIO_SERVICE_SAMPLE_RATE_64000 || \
                       AUDIO_SERVICE_SAMPLE_RATE_96000
        config AUDIO_SERVICE_MCLK_256
            bool "256x"
            depends on !AUDIO_SERVICE_BITS_24 && \
                       !AUDIO_SERVICE_SAMPLE_RATE_88200
        config AUDIO_SERVICE_MCLK_384
            bool "384x"
            depends on AUDIO_SERVICE_SAMPLE_RATE_8000 || \
                       AUDIO_SERVICE_SAMPLE_RATE_16000 || \
                       AUDIO_SERVICE_SAMPLE_RATE_32000 || \
                       AUDIO_SERVICE_SAMPLE_RATE_48000
        config AUDIO_SERVICE_MCLK_512
            bool "512x"
            depends on !AUDIO_SERVICE_BITS_24 && \
                       (AUDIO_SERVICE_SAMPLE_RATE_8000 || \
                        AUDIO_SERVICE_SAMPLE_RATE_11025 || \
                        AUDIO_SERVICE_SAMPLE_RATE_12000 || \
                        AUDIO_SERVICE_SAMPLE_RATE_16000 || \
                        AUDIO_SERVICE_SAMPLE_RATE_22050 || \
                        AUDIO_SERVICE_SAMPLE_RATE_24000 || \
                        AUDIO_SERVICE_SAMPLE_RATE_32000)
        config AUDIO_SERVICE_MCLK_576
            bool "576x"
            depends on AUDIO_SERVICE_SAMPLE_RATE_32000
        config AUDIO_SERVICE_MCLK_768
            bool "768x"
            depends on AUDIO_SERVICE_SAMPLE_RATE_8000 || \
                       AUDIO_SERVICE_SAMPLE_RATE_16000 || \
                       AUDIO_SERVICE_SAMPLE_RATE_24000
        config AUDIO_SERVICE_MCLK_1024
            bool "1024x"
            depends on !AUDIO_SERVICE_BITS_24 && \
                       (AUDIO_SERVICE_SAMPLE_RATE_8000 || \
                        AUDIO_SERVICE_SAMPLE_RATE_11025 || \
                        AUDIO_SERVICE_SAMPLE_RATE_12000 || \
                        AUDIO_SERVICE_SAMPLE_RATE_16000)
        config AUDIO_SERVICE_MCLK_1152
            bool "1152x"
            depends on AUDIO_SERVICE_SAMPLE_RATE_16000
    endchoice

    config AUDIO_SERVICE_MCLK_MULTIPLE
        int
        default 128 if AUDIO_SERVICE_MCLK_128
        default 192 if AUDIO_SERVICE_MCLK_192
        default 256 if AUDIO_SERVICE_MCLK_256
        default 384 if AUDIO_SERVICE_MCLK_384
        default 512 if AUDIO_SERVICE_MCLK_512
        default 576 if AUDIO_SERVICE_MCLK_576
        default 768 if AUDIO_SERVICE_MCLK_768
        default 1024 if AUDIO_SERVICE_MCLK_1024
        default 1152 if AUDIO_SERVICE_MCLK_1152

    config AUDIO_SERVICE_PA_DEFAULT_ON
        bool "Enable the power amplifier while streaming by default"
        default y
endmenu
```

## components/ble_runtime/Kconfig
```kconfig
menu "BLE Runtime"

config BLE_RUNTIME_ADV_FAST_INTERVAL_MS
    int "Fast advertising interval in milliseconds"
    range 20 10240
    default 100
    help
        Connectable advertising interval used during the fast window. This is
        runtime policy, calibrated on hardware; it is not part of the wire
        contract.

config BLE_RUNTIME_ADV_SLOW_INTERVAL_MS
    int "Slow advertising interval in milliseconds"
    range 20 10240
    default 700
    help
        Low-power connectable advertising interval used after the fast window.
        Runtime policy, calibrated on hardware.

config BLE_RUNTIME_ADV_FAST_WINDOW_MS
    int "Fast advertising window in milliseconds"
    range 1000 600000
    default 30000
    help
        Duration of the fast advertising window before falling back to slow
        advertising. Runtime policy, calibrated on hardware.

config BLE_RUNTIME_TX_QUEUE_DEPTH
    int "TX scheduler queue depth"
    range 2 32
    default 8
    help
        Bounded number of pending frames the TX scheduler holds per
        connection. Full queues report ESP_ERR_NO_MEM so callers back off.
        The service submits one whole response at a time: at the mandatory
        MTU of 23 a capabilities response needs about 6 frames, so depths
        below 6 are not guaranteed to deliver MTU-23 responses.

config BLE_RUNTIME_TX_FRAME_BYTES
    int "TX scheduler max frame payload"
    range 20 512
    default 495
    help
        Maximum payload of one notified or indicated frame. 495 bytes fits
        one ATT PDU at the preferred MTU of 498.

endmenu
```

## components/chore_service/Kconfig
```kconfig
menu "Chore service resources"

config CHORE_SERVICE_TASK_STACK_SIZE
    int "Chore worker stack size"
    range 4096 16384
    default 4096
    help
        Worker stack size. The -Wframe-larger-than=2048 compile guard
        bounds single frames but not total usage, so the minimum matches
        the product default; reduce only after a real stack-watermark
        measurement.

config CHORE_SERVICE_JOB_CAPACITY
    int "Chore job capacity"
    range 1 16
    default 8
    help
        Fixed pool slot count. Bounded by the FreeRTOS event-group bits
        used for per-slot cancellation acknowledgement.

endmenu
```

## components/connectivity_manager/Kconfig
```kconfig
menu "MicroTech connectivity manager"

config CONNECTIVITY_MANAGER_TASK_STACK
    int "Connectivity policy worker stack depth"
    default 8192
    range 4096 8192

config CONNECTIVITY_MANAGER_QUEUE_DEPTH
    int "Connectivity policy command queue depth"
    default 8
    range 4 32

endmenu
```

## components/device_link_security/Kconfig
```kconfig
menu "Device Link Security"

config DEVICE_LINK_SECURITY_STORAGE_FAULT_TEST
    bool "Storage fault injection for the hardware matrix (debug only)"
    default n
    help
        Debug-only instrumentation for on-device matrix item 6: injects a
        storage failure or corruption on the durable authorization record
        and revoke-journal writes so the fail-closed paths can be
        exercised on hardware. Production builds must keep this disabled.

config DEVICE_LINK_SECURITY_STORAGE_FAULT_WRITE_N
    int "Fail the Nth durable write (0 = every write)"
    range 0 64
    default 1
    depends on DEVICE_LINK_SECURITY_STORAGE_FAULT_TEST
    help
        The Nth committed-record or revoke-journal write returns
        ESP_ERR_NO_MEM; 0 fails every write. Set above the expected write
        count when pairing with the corrupt-write mode.

config DEVICE_LINK_SECURITY_STORAGE_CORRUPT_WRITE
    bool "Corrupt durable record writes instead of failing them"
    default n
    depends on DEVICE_LINK_SECURITY_STORAGE_FAULT_TEST
    help
        Lands a structurally corrupted blob (flipped magic) instead of
        failing the write, so the fail-closed invalid-record branch can
        be exercised on device.

endmenu
```

## components/device_link_service/Kconfig
```kconfig
menu "Device Link Service"

config DEVICE_LINK_SERVICE_TASK_STACK
    int "Device Link service worker stack size in bytes"
    range 2048 16384
    default 6144
    help
        Worker task stack for the binding window and status machinery.

config DEVICE_LINK_SERVICE_QUEUE_DEPTH
    int "Device Link service command queue depth"
    range 4 32
    default 8
    help
        Bounded command queue depth for window, publish, and teardown
        commands. Commands are rare (window open/close, connect events),
        so a shallow queue is sufficient.

endmenu
```

## components/event_bus/Kconfig
```kconfig
menu "Event bus resources"

config EVENT_BUS_SUBSCRIBER_CAPACITY
    int "Subscriber pool capacity"
    range 1 64
    default 24

config EVENT_BUS_UI_BATCH_CAPACITY
    int "Pending UI batch capacity"
    range 1 16
    default 8
    help
        Maximum number of UI batches pending in the dispatcher queue. It must
        not exceed the depth reported to event_bus_register_ui_dispatch().

config EVENT_BUS_UI_PAYLOAD_SIZE
    int "Maximum UI payload size in bytes"
    range 32 1024
    default 320

config EVENT_BUS_STATS
    bool "Collect dispatch statistics"
    default y

config EVENT_BUS_TRACE
    bool "Log every publication"
    default n
    help
        Compile the publication trace into the event bus. The trace raises
        this file's compile-time log ceiling to debug, but the event_bus log
        tag must still allow ESP_LOG_DEBUG at runtime.

endmenu
```

## components/imu_service/Kconfig
```kconfig
menu "IMU service"

    config IMU_SERVICE_TASK_STACK
        int "IMU worker stack size"
        range 2048 8192
        default 3072

endmenu
```

## components/mt_log/Kconfig
```kconfig
menu "MicroTech logging"

config MT_LOG_DEFAULT_LEVEL
    int "Default compile-time log level (1=Error, 2=Warn, 3=Info, 4=Debug, 5=Verbose)"
    range 1 5
    default 3
    help
        Compile-time verbosity ceiling for source files that do not define
        their own DBG_LVL. A file that defines DBG_LVL keeps its local
        ceiling and is unaffected by this option.
endmenu
```

## components/music_service/Kconfig
```kconfig
menu "Music service"

    config MUSIC_SERVICE_API_TASK_STACK_SIZE
        int "Music API task stack size"
        range 6144 32768
        default 10240

    config MUSIC_SERVICE_AUDIO_TASK_STACK_SIZE
        int "Music audio task stack size"
        range 8192 32768
        default 20480

    config MUSIC_SERVICE_API_QUEUE_DEPTH
        int "Music API command queue depth"
        range 4 16
        default 8

    config MUSIC_SERVICE_MAX_RESPONSE_BYTES
        int "Maximum QQ Music JSON response bytes"
        range 65536 1048576
        default 524288

endmenu
```

## components/nv_storage/Kconfig
```kconfig
menu "NVS storage resources"

config NV_STORAGE_BLOB_POOL_SIZE
    int "In-memory blob pool capacity"
    range 1 64
    default 16

endmenu
```

## components/power_service/Kconfig
```kconfig
menu "Power service"

    config POWER_SERVICE_TASK_STACK
        int "Power worker stack size"
        range 2048 8192
        default 3072

endmenu
```

## components/provisioning_service/Kconfig
```kconfig
menu "MicroTech BLE provisioning"

config PROVISIONING_SERVICE_TASK_STACK
    int "Provisioning worker stack depth"
    default 6144
    range 4096 12288

config PROVISIONING_SERVICE_QUEUE_DEPTH
    int "Provisioning worker queue depth"
    default 8
    range 4 32

config PROVISIONING_SERVICE_DIAGNOSTICS
    bool "Enable provisioning stress diagnostics"
    default n
    help
        Expose development-only protected-request counters and provisioning
        worker stack high-water data. Production builds should leave this off.

endmenu
```
